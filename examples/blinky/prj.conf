## CMakeLists.txt
```
# SPDX-License-Identifier: Apache-2.0

cmake_minimum_required(VERSION 3.21)

find_package(Zephyr HINTS $ENV{ZEPHYR_BASE})
project(blinky)

# If board is nRF9160 add the source files
if (CONFIG_BOARD_CIRCUITDOJO_FEATHER_NRF9160)
    target_sources(app PRIVATE ${ZEPHYR_BASE}/samples/basic/blinky/src/main.c)
elseif(CONFIG_BOARD_CIRCUITDOJO_FEATHER_NRF9161 OR CONFIG_BOARD_CIRCUITDOJO_FEATHER_NRF9151)
    target_sources(app PRIVATE src/main.c)
else()
    message(FATAL_ERROR "Unsupported board")
endif()
```

## prj.conf
```kconfig
CONFIG_GPIO=y
CONFIG_LED=y
CONFIG_MFD=y
CONFIG_I2C=y
CONFIG_LOG=y
```

## src/main.c
```c
/*
 * Copyright (c) 2024 Circuit Dojo LLC
 *
 * SPDX-License-Identifier: Apache-2.0
 */

#include <zephyr/kernel.h>
#include <zephyr/devicetree.h>
#include <zephyr/drivers/led.h>
#include <zephyr/logging/log.h>
LOG_MODULE_REGISTER(main);

static const struct device *leds = DEVICE_DT_GET(DT_NODELABEL(npm1300_leds));

int main(void)
{
    LOG_INF("Blinky Sample");

    while (1)
    {
        led_on(leds, 2U);
        k_sleep(K_MSEC(500));
        led_off(leds, 2U);
        k_sleep(K_MSEC(500));
    }

    return 0;
}
```
